## drivers/misc/mediatek/nfc/Kconfig
```kconfig
##ifdef ODM_HQ_EDIT
##qinchen@ODM.Connectivity.NFC  2020/10/04 bring up nfc

config NFC_CHIP_PN553
	tristate "NFC driver solution - NXP PN553 NFC Controller Driver"
	default n
	depends on I2C
	help
	  NXP PN553 Near Field Communication controller support.
	  If configures to be y, means devices supports NFC functionality.
	  If configures to be n, means devices doesn't support NFC functionality.

##endif /*ODM_HQ_EDIT*/
```

## drivers/soc/oppo/oppo_svelte/Kconfig
```kconfig
config OPPO_SVELTE
	tristate "svelte log driver"
	default y if ((OPPO_MEMLEAK_DETECT = "all") || (OPPO_MEMLEAK_DETECT = "thread"))
	default n
	---help---
	  Log reading and writing is performed via normal Linux reads and
	  optimized writes. This optimization avoids logging having too
	  much overhead in the system.
```
